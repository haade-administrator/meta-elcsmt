## conf/layer.conf
```bitbake
LCONF_VERSION = "7"
BBPATH .= ":${LAYERDIR}"
BBFILES += "${LAYERDIR}/recipes-*/*/*.bb ${LAYERDIR}/recipes-*/*/*.bbappend"
LAYERSERIES_COMPAT_meta-elcsmt = "whinlatter"
```

## conf/machine/rockchip-rk3566-evb.conf
```bitbake
require conf/machine/include/rk356x.inc

MACHINE = "rockchip-rk3566-evb"
KERNEL_DEVICETREE = "rockchip/rk3566-evb2-lp4x-v10-linux.dtb"
UBOOT_MACHINE = "rk3568_defconfig"

RK_WIFIBT_RRECOMMENDS = " \
    rkwifibt-firmware-ap6398s-wifi \
    rkwifibt-firmware-ap6398s-bt \
    brcm-tools \
"

MACHINE_EXTRA_RRECOMMENDS:append = " drm-cursor "
```
